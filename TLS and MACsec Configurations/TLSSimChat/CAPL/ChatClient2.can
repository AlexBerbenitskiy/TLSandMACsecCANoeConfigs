/*@!Encoding:1252*/
// This File controls the client.

/* 
* This CAPL file was made by Vector Informatik for use in the TLS Sample Configuration.
* The following elements were edited or added:
*
* on sysvar sysvar::ChatClient2::Output
* timer1
* timer2
* flag1
* void SendMessage()
* writeBusStatistics()
*/

/*
  This CAPL file implements a chat client application's communication logic with a server. It provides the following functionality:

  1. Initialization:
     - Initializes necessary variables and settings for the client.
       - Variables: kPanelName, kVerbosity, gClientSocket, gReceiveBuffer, gConnectionSecured
       - Methods: on start, ClientStart, ClientStop

  2. Client Start/Stop:
     - Starts or stops the client based on system variable "Enable."
     - Establishes TCP/IP connection with the server (IPv4 or IPv6).
       - Methods: ClientStart, ClientStop, OnTcpConnect

  3. TLS Handshake:
     - Handles TLS handshake for secure communication.
     - Sends the user's login name to the server after handshake completion.
       - Methods: OnTlsHandshakeComplete

  4. Message Sending:
     - Activates when the "send" button is pressed on the client panel.
     - Sends messages to the server using TCP/IP.
     - Manages message loop activation and deactivation.
       - Methods: SendMessage, OnTcpReceive, OnTcpClose

  5. Callbacks:
     - Handles callbacks for TCP connection events (OnTcpConnect, OnTcpClose).
     - Manages callbacks for receiving messages from the server (OnTcpReceive).
       - Methods: OnTcpConnect, OnTcpClose, OnTcpReceive

  6. Bus Load Calculation:
     - Calculates and displays network bus load statistics.
       - Methods: writeBusStatistics

  7. Error Handling:
     - Includes error logging and handling for socket operations.
      - Methods: Error handling within various functions

*/

variables
{
  //
  // Constants
  //

  CHAR      kPanelName[32]  = "Chat Client"; // Name of the panel
  const INT kVerbosity = 0;                    // 1=information to write window, 0=no output to write window

  //
  // Global Variables
  //

  DWORD     gClientSocket;                // The client socket
  CHAR      gReceiveBuffer[200];          // Receive buffer
  INT       gConnectionSecured;
  
   //-------------
  
  
   int flag1 = 0;
   timer timer1;
   timer timer2;
  
  //-------------
  
  
}

on start
{
  if (@sysvar::ChatClient2::Enable > 0)
  {
    ClientStart();
  }
}

/*
  Start Chat Client and connect to server
*/
void ClientStart()
{
  DWORD remoteAddressIPv4;
  BYTE  remoteAddressIPv6[16];
  BYTE  localAddressIPv6[16];
  CHAR  errorText[200];
  CHAR  buf[32];
  LONG  result;

  //
  // Setup Panel Data
  //

  enableControl( kPanelName, "RemoteIPv4Address", 0 );
  enableControl( kPanelName, "RemoteTCPPort"    , 0 );
  enableControl( kPanelName, "LoginName"        , 0 );

  //
  // Setup server address
  //

  sysGetVariableString( sysvar::ChatClient2::ServerAddress, buf, elcount(buf) );
  
  if( ipGetAddressAsArray(buf, remoteAddressIPv6) == 0 )
  {
    //
    // Create IPv6 TCP socket and connect
    //

    if (kVerbosity > 0)
    {
      write( "<%BASE_FILE_NAME%> Connecting to %s ...", buf );
    }
    
    ipGetAddressAsArray("::", localAddressIPv6);
    gClientSocket = TcpOpen( localAddressIPv6, 0 );
    if (IpGetLastSocketError(gClientSocket) != 0)
    {
      IpGetLastSocketErrorAsString( gClientSocket, errorText, elcount(errorText) );
      write( "<%BASE_FILE_NAME%> TcpSocket::open IPv6 failed, %s (Result %d)", errorText, IpGetLastSocketError(gClientSocket) );
      return;
    }

    result = TcpConnect( gClientSocket, remoteAddressIPv6, @sysvar::ChatClient2::ServerPortNumber );
    if (result != 0 && ipGetLastSocketError(gClientSocket) != 10035 ) // WSAEWOULDBLOCK
    {
      IpGetLastSocketErrorAsString(gClientSocket, errorText, elcount(errorText) );
      write( "<%BASE_FILE_NAME%> TcpSocket::connect IPv6 failed, %s (Result %d)", errorText,IpGetLastSocketError(gClientSocket) );
      return;
    }
  }
  else
  {
    remoteAddressIPv4 = IpGetAddressAsNumber( buf );
    //
    // Create IPv4 TCP socket and connect
    //

    if (kVerbosity > 0)
    {
      write( "<%BASE_FILE_NAME%> Connecting to %s ...", buf );
    }

    gClientSocket = TcpOpen( 0, 0 );
    if (IpGetLastSocketError(gClientSocket) != 0)
    {
      IpGetLastSocketErrorAsString( gClientSocket, errorText, elcount(errorText) );
      write( "<%BASE_FILE_NAME%> TcpSocket::open failed, %s (Result %d)", errorText, IpGetLastSocketError(gClientSocket) );
      return;
    }

    result = TcpConnect( gClientSocket, remoteAddressIPv4, @sysvar::ChatClient2::ServerPortNumber );
    if (result != 0 && ipGetLastSocketError(gClientSocket) != 10035 ) // WSAEWOULDBLOCK
    {
      IpGetLastSocketErrorAsString(gClientSocket, errorText, elcount(errorText) );
      write( "<%BASE_FILE_NAME%> TcpSocket::connect failed, %s (Result %d)", errorText,IpGetLastSocketError(gClientSocket) );
      return;
    }
  }
}

void OnTlsHandshakeComplete(dword socket, int result)
{
  CHAR  errorText[200];
  CHAR  userName[32];
  LONG  retVal;

  if (kVerbosity > 0)
  {
    write( "<%BASE_FILE_NAME%> OnTlsHandshakeComplete with result %d, socket 0x%x", result, socket );
  }

  if (result == 0)
  {
    gConnectionSecured = 1;
    
    //
    // Send user name to server
    //

    sysGetVariableString( sysvar::ChatClient2::LoginName, userName, elcount(userName) );
    
    retVal = TcpSend( socket, userName, strlen(userName) );

    if (retVal != 0)
    {
      IpGetLastSocketErrorAsString( socket, errorText, elcount(errorText) );
      write( "<%BASE_FILE_NAME%> TcpSocket::Send failed, %s (Result %d)", errorText, IpGetLastSocketError(socket) );
      return;
    }

    //
    // Receive
    //
    
    TcpReceive( socket, gReceiveBuffer, elcount(gReceiveBuffer) );

    if (IpGetLastSocketError(socket) != 997)
    {
      IPGetLastSocketErrorAsString( socket, errorText, elcount(errorText) );
      write( "<%BASE_FILE_NAME%> TcpSocket::Receive failed, %s (Result %d)", errorText, IpGetLastSocketError(socket) );
      return;
    }

  }
  else
  {
    write( "<%BASE_FILE_NAME%> OnTlsHandshakeComplete failed, result %d", result );
  }
}


/*
  Stop Chat Client and close connection to server
*/
void ClientStop()
{
  if (kVerbosity > 0)
  {
    write( "<%BASE_FILE_NAME%> ClientStop" );
  }

  //
  // Setup Panel Data
  //

  enableControl( kPanelName, "RemoteIPv4Address", 1 );
  enableControl( kPanelName, "RemoteTCPPort"    , 1 );
  enableControl( kPanelName, "LoginName"        , 1 );

  //
  // Close socket
  //

  tlsClose(gClientSocket, 1);
  gClientSocket = 0;
  gConnectionSecured = 0;
}

/*
 * Callback function, if the server has closed the connection.
 *
 * socket - Socket handle of the client
 * result - Result of the operation, 0 on success.
 */
void OnTcpClose( dword socket, long result)
{
  if (kVerbosity > 0)
  {
    write( "<%BASE_FILE_NAME%> TCP connection closed, result %d", result );
  }
  tlsClose(gClientSocket, 1);
  gClientSocket = 0;
  gConnectionSecured = 0;
}

/*
 * Callback for receiving on IPv4 socket
 *
 * socket  - Socket handle of the client
 * result  - Result of the operation, 0 on success
 * address - Remote IPv4 address of the client (in network byte-order!)
 * port    - Remote port number of the client
 * buffer  - Buffer which contains the received data
 * size    - Size in bytes of the received data
 */
void OnTcpReceive( dword socket, long result, dword address, dword port, char buffer[], dword size)
{
  TcpReceiveInternal( socket, result, buffer, size);
}

/*
 * Callback for receiving on IPv6 socket
 *
 * socket  - Socket handle of the client
 * result  - Result of the operation, 0 on success
 * address - Remote IPv6 address of the client (in network byte-order!)
 * port    - Remote port number of the client
 * buffer  - Buffer which contains the received data
 * size    - Size in bytes of the received data
 */
void OnTcpReceive( dword socket, long result, byte address[], dword port, char buffer[], dword size)
{
  TcpReceiveInternal( socket, result, buffer, size);
}

/*
 * Data is received from Chat Server. Put it to text buffer.
 *
 * socket  - Socket handle of the client
 * result  - Result of the operation, 0 on success
 * buffer  - Buffer which contains the received data
 * size    - Size in bytes of the received data
 */
void TcpReceiveInternal( dword socket, long result, char buffer[], dword size)
{
  CHAR errorText[200];
  CHAR receiveText[512];
  LONG retVal;

  //
  // Put text to the panel
  //

  if (kVerbosity > 0)
  {
    write( "<%BASE_FILE_NAME%> TCP received %d bytes, socket 0x%x", size, socket );
  }

  if (result == 0)
  {
    strncpy( receiveText, buffer, size+1 );

    putValueToControl( kPanelName, "ChatOutput", receiveText );
    putValueToControl( kPanelName, "ChatOutput", "\n" );

    //
    // Receive
    //

    TcpReceive( socket, gReceiveBuffer, elcount(gReceiveBuffer) );

    if (ipGetLastSocketError(socket) != 997)
    {
      IpGetLastSocketErrorAsString( socket, errorText, elcount(errorText) );
      write( "<%BASE_FILE_NAME%> TcpSocket::Receive failed, %s (Result %d)", errorText, retVal );
      return;
    }
  }
  else
  {
    write( "<%BASE_FILE_NAME%> OnTcpReceive failed, gResult %d", result );
  }
}

/*
 * Start or stop the client with the system variable 'Enable', whicht
 * is assigned to a switch in a panel.
 */
on sysvar sysvar::ChatClient2::Enable
{
  if (@this == 1)
  {
    ClientStart();
  }
  else
  {
    ClientStop();
  }
}



//-------------------------------------MESSAGE ACTIVATION-----------------------------------------

/*
 * The message transmission is activated once the "send" button on the client panel is pressed. 
 * Once CAPL detects that the button was pressed, it activates timer1 and flag1. This starts a message sending loop.
 * If the button is pressed a second time, flag1 will be resent to 0 and the message transmisison will come to a halt.
 */
on sysvar sysvar::ChatClient2::Output
{
  if ((gClientSocket) && (gConnectionSecured) && (@this == 1) && (flag1 == 0))
  {
    SendMessage();
    
    flag1 = 1;
    setTimer(timer1,0);
  }
     else if ((gClientSocket) && (gConnectionSecured) && (@this == 1) && (flag1 == 1))
  {
  flag1 = 0;
  }
  
}


on timer timer1 {
 if(flag1 ==1){
 sendMessage();
 setTimer(timer2, 1);
   }
}

on timer timer2 {
 if(flag1 ==1){
 sendMessage();
 setTimer(timer1, 1);
}
}


//----------------------------------------------------------------------------------------------------


/*
 * Callback, which is called on connect to server
 *
 * socket - Socket handle
 * result - Result of the operation, 0 on success.
 */
void OnTcpConnect( dword socket, long result)
{
  CHAR errorText[200];

  if (kVerbosity > 0)
  {
    write( "<%BASE_FILE_NAME%> OnTcpConnect with result %d, socket 0x%x", result, socket );
  }
  
  if (result == 0)
  {
    gClientSocket = tlsOpen(gClientSocket);
    result = tlsAuthenticateAsClientWithConfiguration(gClientSocket, "Initial TLS Configuration");
    if ((tlsGetLastError(gClientSocket) != 0) && (tlsGetLastError(gClientSocket) != 997))
    {
      tlsGetLastErrorAsString(gClientSocket, errorText, elcount(errorText) );
      write( "<%BASE_FILE_NAME%> tlsAuthenticateAsClientWithConfiguration failed, %s (Result %d)", errorText, tlsGetLastError(gClientSocket) );
      return;
    }
  }
  else
  {
    write( "<%BASE_FILE_NAME%> OnTcpConnect failed, result %d", result );
  }
}



//--------------------------SEND MESSAGE ---------------------------------
/*
 * Send text of SysVar ChatClient2::Text to server.
 */
void SendMessage()
{
  
  CHAR text[200];
  
  writeBusStatistics(); //Turned off as bus statistics function not working

  sysGetVariableString( sysvar::ChatClient2::Text, text, elcount(text) );

  TcpSend( gClientSocket, text, strlen(text) );

  if (IPGetLastSocketError(gClientSocket) != 0)
  {
    IPGetLastSocketErrorAsString( gClientSocket, text, elcount(text) );
    write( "<%BASE_FILE_NAME%> TcpSocket::send failed, %s (Result %d)", text, IpGetLastSocketError(gClientSocket) );
  }
}

 // --------------------BUS LOAD-------------------------------------------------

/*
* This function was aquired from Vector Knowledge Base
* Available at:
https://support.vector.com/kb?sys_kb_id=8ec53c8f87b42950cd36fd99cebb353f&id=kb_article_view&sysparm_rank=2&sysparm_tsqueryId=04a542fc876902588816dd383cbb35f4
*/


writeBusStatistics() { 
  
  qword linkSpeed;
  float rxDataRateCurr, txDataRateCurr, rxDataRateMax, txDataRateMax;
  float rxBusload, txBusload, rxPeakload, txPeakload;
  ethernetport port;
  
  port = ethernetPort::Ethernet::Port1;  // Ethernet port chosen (Port1 which is the client)

  
  
  linkSpeed = ethGetLinkSpeed(port, eCurrValue); // mbit, enum ValueSelector - Client
  
  //Client
  rxDataRateCurr = ethGetRxBitRate(port, eCurrValue)/1000000.0; // bit -> Mbit 
  txDataRateCurr = ethGetTxBitRate(port, eCurrValue)/1000000.0;
  rxDataRateMax = ethGetRxBitRate(port, eMaxValue)/1000000.0;
  txDataRateMax = ethGetTxBitRate(port, eMaxValue)/1000000.0;
  
  
  if(linkSpeed > 0) {                            
 
    //Client
      rxBusload = rxDataRateCurr*100/linkSpeed;    
      txBusload = txDataRateCurr*100/linkSpeed;
      rxPeakload = rxDataRateMax*100/linkSpeed; 
      txPeakload = txDataRateMax*100/linkSpeed;
    
      }
  
  write("====c=====\nLinkSpeed: %llu MBit/s \nRxRate: %g MBit/s\nTxRate: %g MBit/s \nRxBusload: %g %% \nTxBusload: %g %% \nRxPeakload: %g %% \nTxPeakload: %g %% \n=====", linkSpeed, rxDataRateCurr, txDataRateCurr, rxBusload, txBusload, rxPeakload, txPeakload); 
}


